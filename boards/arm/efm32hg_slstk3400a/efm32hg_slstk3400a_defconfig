## boards/arm/efm32hg_slstk3400a/efm32hg_slstk3400a_defconfig
```kconfig
CONFIG_ARM=y
CONFIG_SOC_FAMILY_EXX32=y
CONFIG_SOC_SERIES_EFM32HG=y
CONFIG_BOARD_EFM32HG_SLSTK3400A=y
CONFIG_CONSOLE=y
CONFIG_UART_CONSOLE=y
CONFIG_SERIAL=y
CONFIG_CORTEX_M_SYSTICK=y
CONFIG_GPIO=y
CONFIG_SYS_CLOCK_HW_CYCLES_PER_SEC=24000000
CONFIG_CMU_HFCLK_HFXO=y
CONFIG_NEWLIB_LIBC=y
```
